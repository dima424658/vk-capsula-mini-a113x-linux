## Documentation/devicetree/bindings/auxdisplay/led-7-segment.yaml
```yaml
# SPDX-License-Identifier: (GPL-2.0-only OR BSD-2-Clause)
%YAML 1.2
---
$id: http://devicetree.org/schemas/auxdisplay/led-7-segment.yaml#
$schema: http://devicetree.org/meta-schemas/core.yaml#

title: Seven-segment display made of LEDs

maintainers:
  - cmp18 <comp18man@gmail.com>

description: |
  A display of one or more seven-segment digits whose segments are LEDs of
  one or more LED controllers rather than GPIOs. Each digit takes seven LEDs,
  segments a to g:

           -a-
          |   |
          f   b
          |   |
           -g-
          |   |
          e   c
          |   |
           -d-

  A decimal point or a colon is not part of a character cell and stays a
  plain LED.

properties:
  compatible:
    const: led-7-segment

  leds:
    $ref: /schemas/types.yaml#/definitions/phandle-array
    minItems: 7
    items:
      maxItems: 1
    description:
      The segment LEDs, a to g for each digit, digits from left to right. The
      count is a multiple of seven.

  led-maps:
    $ref: /schemas/types.yaml#/definitions/phandle-array
    minItems: 14
    items:
      maxItems: 1
    description:
      Two complete maps of equal length, each listing segments a to g for each
      digit from left to right. The preferred map comes first and the fallback
      map second. The driver selects the first map whose LEDs are registered.

  alternate-led-map:
    type: boolean
    description:
      The led-maps property contains two alternative maps. This uses a custom
      property so firmware device links do not require both optional LED
      controllers to be present.

  default-brightness-level:
    $ref: /schemas/types.yaml#/definitions/uint32
    description:
      Brightness of a lit segment. Defaults to, and is capped at, the highest
      brightness all the LEDs support.

required:
  - compatible

allOf:
  - if:
      required:
        - alternate-led-map
    then:
      required:
        - led-maps
      properties:
        leds: false
    else:
      required:
        - leds
      properties:
        led-maps: false

additionalProperties: false

examples:
  - |
    display {
        compatible = "led-7-segment";
        leds = <&seg_a>, <&seg_b>, <&seg_c>, <&seg_d>,
               <&seg_e>, <&seg_f>, <&seg_g>;
    };
```

## Documentation/devicetree/bindings/leds/awinic,aw21036.yaml
```yaml
# SPDX-License-Identifier: (GPL-2.0-only OR BSD-2-Clause)
%YAML 1.2
---
$id: http://devicetree.org/schemas/leds/awinic,aw21036.yaml#
$schema: http://devicetree.org/meta-schemas/core.yaml#

title: Awinic AW21036 LED controller

maintainers:
  - Dmitry Pankov <dmitry@enula.ru>

description: |
  The AW21036 is a 36-channel LED controller connected over I2C. Each
  channel is exposed as an individual LED class device.

properties:
  compatible:
    const: awinic,aw21036

  reg:
    maxItems: 1

  enable-gpios:
    maxItems: 1
    description: Active-high hardware enable input.

  awinic,global-current:
    $ref: /schemas/types.yaml#/definitions/uint32
    minimum: 0
    maximum: 255
    description: Global current control value written to the GCCR register.

  "#address-cells":
    const: 1

  "#size-cells":
    const: 0

patternProperties:
  "^led@[0-9a-f]+$":
    type: object
    $ref: common.yaml#
    unevaluatedProperties: false
    properties:
      reg:
        description: AW21036 channel number, from 1 to 36.
        items:
          minimum: 1
          maximum: 36

required:
  - compatible
  - reg

additionalProperties: false

examples:
  - |
    i2c {
        #address-cells = <1>;
        #size-cells = <0>;

        led-controller@34 {
            compatible = "awinic,aw21036";
            reg = <0x34>;
            awinic,global-current = <128>;
            #address-cells = <1>;
            #size-cells = <0>;

            led@1 {
                reg = <1>;
                label = "clock:d2:d";
            };
        };
    };
```
